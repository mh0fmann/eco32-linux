## arch/eco32/Kconfig
```kconfig
#
# For a description of the syntax of this configuration file,
# see Documentation/kbuild/kconfig-language.txt.
#

#--------------- ECO32 FIX ----------------

#
# This part contains fixed options for our architecture.
# Choices made here are not configurable and need to be like this
# or the build will break
#

config ECO32
    bool
    default y
    select TINY_RCU
    select EMBEDDED
    select NO_BOOTMEM
    select HAVE_MEMBLOCK
    select GENERIC_CLOCKEVENTS
    select GENERIC_STRNLEN_USER
    select GENERIC_STRNCPY_FROM_USER
    select GENERIC_IOMAP
    select GENERIC_ATOMIC64
    select GENERIC_IRQ_SHOW
    select GENERIC_FIND_FIRST_BIT
    select OF
    select OF_EARLY_FLATTREE
    select OF_IRQ
    select IRQ_DOMAIN
    select ECO32_TIMERS

config GENERIC_CSUM
    def_bool y

config GENERIC_CALIBRATE_DELAY
    def_bool y

config GENERIC_HWEIGHT
    def_bool y

config RWSEM_GENERIC_SPINLOCK
    def_bool y

config NO_DMA
    def_bool y
    
config CPU_BIG_ENDIAN
    def_bool y

config SYS_SUPPORTS_BIG_ENDIAN
    def_bool y

config NR_CPUS
    int
    default 1

config HZ
    int
    default 100

config MMU
    def_bool y


#---------------- ARCH CONFIG ---------------

menu "ECO32 Kernel features"

config ECO32_SIMULATOR
    bool "Compile Linux for the ECO32 simulator"
    default y
    ---help---
    The ECO32 has little more features than the real hardware.
    The shutdown device is one of those. If you plan to run the kernel
    only on the simulator you can say yes here

#
# On eco32 we accept arguments for the kernel from a bootloader in
# register 4 to 7
#
# $4 : cmdline
# $5 : device tree
# $6 : initrd start
# $7 : initrd end
#
config ARGUMENT_PASSING
    bool "Enable argument passing from bootloader"
    default y
    ---help---
    Say yes here if you want to be able to pass arguments from the bootloader
    to linux

config ARGUMENT_CMDLINE
    bool "Accept the kernel commandline from the bootloader"
    default y
    depends on ARGUMENT_PASSING
    ---help---
    Say yes here if you want to be able to pass a kernel command line from the
    bootloader to the kernel. This will always overwrite the arguments specified
    in the device tree

config ARGUMENT_DEVICETREE
    bool "Accept the device tree from the bootloader"
    default y
    depends on ARGUMENT_PASSING
    ---help---
    Say yes here if you want to be able to pass a devicetree from the bootloader
    to the kernel

config ARGUMENT_INITRD
    bool "Accept the initrd from the bootloader"
    default n
    depends on ARGUMENT_PASSING
    depends on BLK_DEV_INITRD
    ---help---
    Say yes here if you want to be able to pass the initrd from the bootloader
    to the kernel



config BUILTIN_DTB
    bool "Use builtin device tree"
    default y
    ---help---
    If you want or need to use a builtin device tree say yes here

config ECO32_BUILTIN_DTB
    string  "Choose which builtin device tree to use"
    default "eco32sim"
    depends on BUILTIN_DTB
    ---help---
    Choose the default Builtin Device Tree which should be compiled
    in the kernel.

endmenu


#------------------------------------------


source "kernel/Kconfig.hz"
```

## arch/eco32/Kconfig.debug
```kconfig
config EARLY_PRINTK
    bool "Enable early prinkt"
    default n
    ---help---
    Choose this to activate early kernel outputs befor the first console
    gets registered
```

## arch/eco32/configs/eco32_defconfig
```kconfig
# default configuration for linux running on the eco32 simulator
CONFIG_EXPERT=y
CONFIG_SLOB=y
CONFIG_EARLY_PRINTK=y
CONFIG_PANIC_ON_OOPS=y
CONFIG_CC_OPTIMIZE_FOR_SIZE=y
# CONFIG_MODULES is not set
# CONFIG_HIGHMEM is not set
# CONFIG_KALLSYMS is not set
# CONFIG_FHANDLE is not set
# CONFIG_FW_LOADER is not set
# CONFIG_AIO is not set
# CONFIG_MISC_FILESYSTEMS is not set
# CONFIG_PROC_SYSCTL is not set
# CONFIG_USB_SUPPORT is not set
# CONFIG_CROSS_MEMORY_ATTACH is not set
# CONFIG_HID is not set
CONFIG_TTY=y
CONFIG_INPUT_KEYBOARD=y
# CONFIG_KEYBOARD_ATKBD is not set
CONFIG_INPUT_EVDEV=y
# CONFIG_INPUT_MOUSE is not set
# CONFIG_HWMON is not set
# CONFIG_IOMMU_SUPPORT is not set
# CONFIG_SERIO_SERPORT is not set
# CONFIG_RC_CORE is not set
# CONFIG_LBDAF is not set
# CONFIG_IOSCHED_CFQ is not set
# CONFIG_IOSCHED_DEADLINE is not set
# CONFIG_MQ_IOSCHED_KYBER is not set
# CONFIG_MQ_IOSCHED_DEADLINE is not set
CONFIG_BLOCK=y
CONFIG_EXT2_FS=y
CONFIG_EXT2_FS_XATTR=y
# CONFIG_NETWORK_FILESYSTEMS is not set
CONFIG_TMPFS=y
CONFIG_DEVTMPFS=y
CONFIG_DEVTMPFS_MOUNT=y
CONFIG_PARTITION_ADVANCED=y
# CONFIG_EFI_PARTITION is not set
# CONFIG_MSDOS_PARTITION is not set
CONFIG_ECO32_PARTITION=y
# CONFIG_BLK_DEV_BSG is not set
# CONFIG_VGA_CONSOLE is not set
# CONFIG_HW_RANDOM is not set
# CONFIG_DEVMEM is not set
# CONFIG_RD_GZIP
# CONFIG_RD_BZIP2 is not set
# CONFIG_RD_LZMA is not set
# CONFIG_RD_XZ is not set
# CONFIG_RD_LZO is not set
# CONFIG_RD_LZ4 is not set
CONFIG_FB=y
CONFIG_FRAMEBUFFER_CONSOLE=y
CONFIG_VT=y
CONFIG_LOGO=y
CONFIG_LOGO_THM_CLUT224=y
# CONFIG_LOGO_LINUX_MONO is not set
# CONFIG_LOGO_LINUX_VGA16 is not set
# CONFIG_LOGO_LINUX_CLUT224 is not set
# CONFIG_UNIX98_PTYS is not set
# CONFIG_LEGACY_PTYS is not set
CONFIG_NET=y
CONFIG_UNIX=y
# CONFIG_WIRELESS is not set
CONFIG_BLK_DEV_INITRD=y
```
